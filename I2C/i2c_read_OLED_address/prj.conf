## CMakeLists.txt
```
cmake_minimum_required(VERSION 3.20.0)
set(SHIELD ssd1306_128x64)
find_package(Zephyr REQUIRED HINTS $ENV{ZEPHYR_BASE})

project(i2c_read_OLED_address)

target_sources(app PRIVATE src/main.c)
```

## prj.conf
```kconfig
CONFIG_LV_Z_MEM_POOL_NUMBER_BLOCKS=8
CONFIG_MAIN_STACK_SIZE=2048

CONFIG_DISPLAY=y
CONFIG_DISPLAY_LOG_LEVEL_ERR=y

CONFIG_LOG=y

CONFIG_LVGL=y
CONFIG_LV_MEM_CUSTOM=y
CONFIG_LV_USE_LOG=y
CONFIG_LV_USE_LABEL=y
CONFIG_LV_USE_BTN=y
CONFIG_LV_USE_IMG=y
CONFIG_LV_FONT_MONTSERRAT_14=y

CONFIG_I2C=y
CONFIG_PRINTK=y
CONFIG_LOG=y
CONFIG_CBPRINTF_FP_SUPPORT=y
CONFIG_I2C_LOG_LEVEL_OFF=y
```

## src/main.c
```c
#include <zephyr/device.h>
#include <zephyr/drivers/display.h>
#include <lvgl.h>
#include <stdio.h>
#include <string.h>
#include <zephyr/kernel.h>

#define LOG_LEVEL CONFIG_LOG_DEFAULT_LEVEL
#include <zephyr/logging/log.h>
LOG_MODULE_REGISTER(app);

int main(void)
{
        const struct device *display_dev;
        lv_obj_t *hello_world_label;
        lv_obj_t *count_label;

        display_dev = DEVICE_DT_GET(DT_CHOSEN(zephyr_display));
        if (!device_is_ready(display_dev))
        {
                LOG_ERR("Device not ready, aborting test");
                return 0;
        }

        if (IS_ENABLED(CONFIG_LV_Z_POINTER_KSCAN))
        {
                lv_obj_t *hello_world_button;

                hello_world_button = lv_btn_create(lv_scr_act());
                lv_obj_align(hello_world_button, LV_ALIGN_CENTER, 0, 0);
                hello_world_label = lv_label_create(hello_world_button);
        }
        else
        {
                hello_world_label = lv_label_create(lv_scr_act());
        }
        
        lv_label_set_text(hello_world_label, "IndieSemiC\n Pvt. Ltd.");
        lv_obj_align(hello_world_label, LV_ALIGN_CENTER, 0, 0);

        count_label = lv_label_create(lv_scr_act());
        lv_obj_align(count_label, LV_ALIGN_BOTTOM_MID, 0, 0);
      
        lv_task_handler();
        display_blanking_off(display_dev);
}
```
