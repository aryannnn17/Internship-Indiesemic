## LCD1602_ExamDevice/boards/arm/isc_nrf52832_a/Kconfig.board
```kconfig
# Copyright (c) 2024 Nordic Semiconductor ASA
# SPDX-License-Identifier: Apache-2.0

config BOARD_ISC_NRF52832_A
	bool "ISC-NRF52832-A"
	depends on SOC_NRF52832_QFAA
```

## LCD1602_ExamDevice/boards/arm/isc_nrf52832_a/Kconfig.defconfig
```kconfig
# Copyright (c) 2024 Nordic Semiconductor ASA
# SPDX-License-Identifier: Apache-2.0

if BOARD_ISC_NRF52832_A

config BOARD
	default "isc_nrf52832_a"

config BT_CTLR
   default BT


endif
```

## LCD1602_ExamDevice/boards/arm/nrf52840_gps/Kconfig.defconfig
```kconfig
# Copyright (c) 2024 Nordic Semiconductor ASA
# SPDX-License-Identifier: Apache-2.0

if BOARD_NRF52840_GPS

config BOARD
	default "nrf52840_gps"

config BT_CTLR
   default BT

endif
```
